## CMakeLists.txt
```
# Copyright 2021-2024 NXP
# SPDX-License-Identifier: Apache-2.0

cmake_minimum_required(VERSION 3.20.0)

find_package(Zephyr REQUIRED HINTS $ENV{ZEPHYR_BASE})
project(ex_qi_provision)

FILE(
    GLOB
    SRC_FILES
    ../*.c
    ../port/*.c
)

target_sources(app PRIVATE src/main.c ${SRC_FILES})
target_include_directories(
    app
    PRIVATE ../../src/
    PRIVATE ../
    PRIVATE ../port/
)
```

## prj.conf
```kconfig
CONFIG_PLUGANDTRUST=y

CONFIG_PLUGANDTRUST_SCP03=y
CONFIG_PLUGANDTRUST_ECKEY=n
CONFIG_PLUGANDTRUST_ECKEY_SCP03=n

CONFIG_PLUGANDTRUST_APDU_BUFFER_SIZE=200

CONFIG_MAIN_STACK_SIZE=2048
CONFIG_ISR_STACK_SIZE=100
CONFIG_IDLE_STACK_SIZE=220
CONFIG_SYSTEM_WORKQUEUE_STACK_SIZE=0
CONFIG_PRIVILEGED_STACK_SIZE=0
CONFIG_GPIO=n
CONFIG_SPI=n

CONFIG_LOG=n
CONFIG_PLUGANDTRUST_LOG_LEVEL_DBG=n
CONFIG_LOG_MODE_IMMEDIATE=n
```

## boards/frdm_k64f.overlay
```dts
/*
 * SPDX-License-Identifier: Apache-2.0
 */

/

{
	aliases {
		se05x-i2c = &i2c0;
	};
};

&i2c0 {
	status = "okay";
};
```

## src/main.c
```c
/** @file main.c
 *  @brief .
 *
 * Copyright 2021,2024 NXP
 * SPDX-License-Identifier: Apache-2.0
 */

/* ********************** Include files ********************** */
#include <zephyr/sys/printk.h>
#include <zephyr/kernel.h>

/* ********************** Extern functions ********************** */
extern int set_qi_key_cert(void);

int main(void)
{
    printk("Se05x Qi Provisioning Example ! %s\n", CONFIG_BOARD);
    if (set_qi_key_cert() != 0) {
        printk("SE05x Qi Provisioning Example Failed !\n");
    }
    else {
        printk("SE05x Qi Provisioning Example Success ! \n");
    }
    return 0;
}
```
