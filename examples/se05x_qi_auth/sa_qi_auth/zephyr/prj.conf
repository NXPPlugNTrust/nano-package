## CMakeLists.txt
```
# Copyright 2021-2024 NXP
# SPDX-License-Identifier: Apache-2.0

cmake_minimum_required(VERSION 3.20.0)

find_package(Zephyr REQUIRED HINTS $ENV{ZEPHYR_BASE})
project(ex_qi_auth)

FILE(
    GLOB
    SRC_FILES
    ../*.c
    ../port/*.c
    ../../sa_qi_transmitter_auth/*.c
    ../../sa_qi_transmitter_auth/port/*.c
)

target_sources(app PRIVATE src/main.c ${SRC_FILES})
zephyr_include_directories(
    src/
    ../../src/
    ../
    ../port
    ../../sa_qi_transmitter_auth
    ../../sa_qi_transmitter_auth/port
)
```

## sample.yaml
```
sample:
  description: SE05x sign example
  name: se05x_sign
common:
    tags: introduction
    harness_config:
      type: one_line
      regex:
        - "se05x sign! (.*)"
```

## prj.conf
```kconfig
CONFIG_PLUGANDTRUST=y

CONFIG_PLUGANDTRUST_SCP03=n
CONFIG_PLUGANDTRUST_ECKEY=n
CONFIG_PLUGANDTRUST_ECKEY_SCP03=n

CONFIG_MAIN_STACK_SIZE=5000
CONFIG_ISR_STACK_SIZE=100
CONFIG_IDLE_STACK_SIZE=220
CONFIG_SYSTEM_WORKQUEUE_STACK_SIZE=0
CONFIG_PRIVILEGED_STACK_SIZE=0
CONFIG_GPIO=n
CONFIG_SPI=n

CONFIG_LOG=n
CONFIG_PLUGANDTRUST_LOG_LEVEL_DBG=n
CONFIG_LOG_MODE_IMMEDIATE=n
CONFIG_HEAP_MEM_POOL_SIZE=1500

# Enable MBEDTLS
CONFIG_MBEDTLS=y
CONFIG_MBEDTLS_BUILTIN=y
CONFIG_MBEDTLS_USER_CONFIG_ENABLE=y
CONFIG_MBEDTLS_USER_CONFIG_FILE="user-tls_plugandtrust.conf"

CONFIG_MBEDTLS_ENABLE_HEAP=y
CONFIG_MBEDTLS_HEAP_SIZE=5120
CONFIG_MBEDTLS_PEM_CERTIFICATE_FORMAT=y

# Enable RNG for platform
CONFIG_ENTROPY_MCUX_RNG=y
CONFIG_ENTROPY_GENERATOR=y
CONFIG_HARDWARE_DEVICE_CS_GENERATOR=y
```

## src/main.c
```c
/** @file main.c
 *  @brief .
 *
 * Copyright 2021,2024 NXP
 * SPDX-License-Identifier: Apache-2.0
 */

/* ********************** Include files ********************** */
#include <zephyr/sys/printk.h>
#include <zephyr/kernel.h>
#include "se05x_tlv.h"
#include "se05x_APDU_apis.h"
#include "sa_qi_port.h"

/* ********************** Extern functions ********************** */
extern int ex_qi_entry(void);

Se05xSession_t se05x_session      = {0};
pSe05xSession_t pgSe05xSessionctx = &se05x_session;

int main(void)
{
    smStatus_t status = SM_NOT_OK;
    printk("Se05x Qi Auth Example ! %s\n", CONFIG_BOARD);

    status = Se05x_API_SessionOpen(&se05x_session);
    if (status != SM_OK) {
        LOG_E("Error in Se05x_API_SessionOpen");
        return 0;
    }

    if (ex_qi_entry() != 0) {
        printk("SE05x Qi Auth Example Failed !\n");
    }
    else {
        printk("SE05x Qi Auth Example Success ! \n");
    }

    status = Se05x_API_SessionClose(&se05x_session);
    if (status != SM_OK) {
        LOG_E("Error in Se05x_API_SessionClose");
        return 0;
    }

    return 0;
}
```
