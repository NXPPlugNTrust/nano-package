## CMakeLists.txt
```
# Copyright 2024 NXP
# SPDX-License-Identifier: Apache-2.0

cmake_minimum_required(VERSION 3.20.0)

find_package(Zephyr REQUIRED HINTS $ENV{ZEPHYR_BASE})
project(ex_se05x_mbedtls_alt_test)

target_sources(app PRIVATE src/main.c ../src/ex_se05x_mbedtls_alt_test.c)

zephyr_include_directories(${APPLICATION_SOURCE_DIR})
```

## sample.yaml
```
sample:
  description: se05x mbedtls alt test
  name: se05x_mbedtls_alt_test
common:
    tags: introduction
    harness_config:
      type: one_line
      regex:
        - "ecdsa verify using host (mbedtls) success.! (.*)"
```

## prj.conf
```kconfig
CONFIG_PLUGANDTRUST=y

CONFIG_PLUGANDTRUST_SCP03=n
CONFIG_PLUGANDTRUST_ECKEY=n
CONFIG_PLUGANDTRUST_ECKEY_SCP03=n
CONFIG_PLUGANDTRUST_SM_APDU_MUTEX=n

CONFIG_LOG=y
CONFIG_PLUGANDTRUST_LOG_LEVEL_DBG=n
CONFIG_LOG_MODE_IMMEDIATE=y
CONFIG_MAIN_STACK_SIZE=8000
CONFIG_PLUGANDTRUST_MBEDTLS_ALT=y

# Enable MBEDTLS
CONFIG_MBEDTLS=y
CONFIG_MBEDTLS_BUILTIN=y
CONFIG_MBEDTLS_ENABLE_HEAP=y
CONFIG_MBEDTLS_HEAP_SIZE=56240
CONFIG_MBEDTLS_USER_CONFIG_ENABLE=y
CONFIG_MBEDTLS_USER_CONFIG_FILE="user-mbedtls-alt-tst.conf"
```

## user-mbedtls-alt-tst.conf
```kconfig
#define MBEDTLS_ENTROPY_C

#define MBEDTLS_ECP_C
#define MBEDTLS_ECP_DP_SECP256R1_ENABLED
#define MBEDTLS_ECDSA_C

#define MBEDTLS_PEM_WRITE_C
#define MBEDTLS_BASE64_C
#define MBEDTLS_OID_C
#define MBEDTLS_ASN1_WRITE_C
#define MBEDTLS_PK_WRITE_C
#define MBEDTLS_PK_C

#define MBEDTLS_ECDSA_SIGN_ALT

#define MBEDTLS_ASN1_PARSE_C
#define MBEDTLS_ASN1_WRITE_C
#define MBEDTLS_BIGNUM_C
#define MBEDTLS_CTR_DRBG_C
#define MBEDTLS_AES_C
#define MBEDTLS_PK_PARSE_C
```

## src/main.c
```c
/** @file main.c
 *  @brief .
 *
 * Copyright 2024 NXP
 * SPDX-License-Identifier: Apache-2.0
 */

/* ********************** Include files ********************** */
#include <zephyr/kernel.h>
#include <zephyr/sys/printk.h>

/* ********************** Extern functions ********************** */
extern int ex_se05x_mbedtls_alt_test();

int main(void)
{
    printk("Se05x Mbedtls Alt Test ! %s\n", CONFIG_BOARD);
    if (ex_se05x_mbedtls_alt_test() != 0) {
        printk("Se05x Mbedtls Alt Test Failed !\n");
    }
    else {
        printk("Se05x Mbedtls Alt Test Success !\n");
    }
    return 0;
}
```
