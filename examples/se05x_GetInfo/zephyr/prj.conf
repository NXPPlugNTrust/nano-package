## CMakeLists.txt
```
# Copyright 2021-2024 NXP
# SPDX-License-Identifier: Apache-2.0

cmake_minimum_required(VERSION 3.20.0)

find_package(Zephyr REQUIRED HINTS $ENV{ZEPHYR_BASE})
project(ex_se05x_GetInfo)

target_sources(app PRIVATE src/main.c ../src/ex_se05x_GetInfo.c)
```

## sample.yaml
```
sample:
  description: SE05x GetInfo example
  name: se05x_GetInfo
common:
    tags: introduction
    harness_config:
      type: one_line
      regex:
        - "SE05x GetInfo! (.*)"
```

## prj.conf
```kconfig
CONFIG_PLUGANDTRUST=y

CONFIG_PLUGANDTRUST_SCP03=n
CONFIG_PLUGANDTRUST_ECKEY=n
CONFIG_PLUGANDTRUST_ECKEY_SCP03=n
CONFIG_PLUGANDTRUST_SM_APDU_MUTEX=n

CONFIG_MAIN_STACK_SIZE=3000
CONFIG_GPIO=n
CONFIG_SPI=n

CONFIG_LOG=y
CONFIG_PLUGANDTRUST_LOG_LEVEL_DBG=n
CONFIG_LOG_MODE_IMMEDIATE=y
```

## boards/frdm_k64f.overlay
```dts
/*
 * Copyright 2024 NXP
 * SPDX-License-Identifier: Apache-2.0
 */

/

{
	aliases {
		se05x-i2c = &i2c0;
	};
};

&i2c0 {
	status = "okay";
};
```

## src/main.c
```c
/** @file main.c
 *  @brief .
 *
 * Copyright 2023,2024 NXP
 * SPDX-License-Identifier: Apache-2.0
 */

/* ********************** Include files ********************** */
#include <zephyr/kernel.h>
#include <zephyr/sys/printk.h>

/* ********************** Extern functions ********************** */
extern int ex_se05x_GetInfo(void);

int main(void)
{
    printk("Se05x GetInfo Example ! %s\n", CONFIG_BOARD);
    if (ex_se05x_GetInfo() != 0) {
        printk("SE05x GetInfo Example Failed !\n");
    }
    else {
        printk("SE05x GetInfo Example Success ! \n");
    }
    return 0;
}
```
