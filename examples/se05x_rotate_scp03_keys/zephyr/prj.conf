## CMakeLists.txt
```
# Copyright 2021-2024 NXP
# SPDX-License-Identifier: Apache-2.0

cmake_minimum_required(VERSION 3.20.0)

find_package(Zephyr REQUIRED HINTS $ENV{ZEPHYR_BASE})
project(ex_se05x_rotate_scp03_keys)

target_sources(app PRIVATE src/main.c ../src/ex_se05x_rotate_scp03_keys.c)

add_definitions(-DEX_SE05X_USE_TC)
```

## sample.yaml
```
sample:
  description: se05x rotate scp03 keys example
  name: se05x_rotate_scp03_keys
tests:
  nxp-plugandtrust.examples.se05x_rotate_scp03_keys:
    platform_allow: frdm_k64f
    build_only: true
    tags: se05x
```

## prj.conf
```kconfig
CONFIG_PLUGANDTRUST=y

CONFIG_PLUGANDTRUST_SCP03=y
CONFIG_PLUGANDTRUST_ECKEY=n
CONFIG_PLUGANDTRUST_ECKEY_SCP03=n
CONFIG_PLUGANDTRUST_SM_APDU_MUTEX=n

CONFIG_MAIN_STACK_SIZE=2000
CONFIG_GPIO=n
CONFIG_SPI=n

CONFIG_LOG=y
CONFIG_PLUGANDTRUST_LOG_LEVEL_DBG=n
CONFIG_LOG_MODE_IMMEDIATE=y
```

## src/main.c
```c
/** @file main.c
 *  @brief .
 *
 * Copyright 2021,2022,2024 NXP
 * SPDX-License-Identifier: Apache-2.0
 */

/* ********************** Include files ********************** */
#include <zephyr/kernel.h>
#include <zephyr/sys/printk.h>

/* ********************** Extern functions ********************** */
extern int ex_se05x_rotate_scp03_keys();

int main(void)
{
    printk("Se05x Rotate SCP03 keys Example ! %s\n", CONFIG_BOARD);
    if (ex_se05x_rotate_scp03_keys() != 0) {
        printk("SE05x Rotate SCP03 keys Example Failed !\n");
    }
    else {
        printk("SE05x Rotate SCP03 keys Example Success ! \n");
    }
    return 0;
}
```
