## CMakeLists.txt
```
# Copyright 2024 NXP
# SPDX-License-Identifier: Apache-2.0

cmake_minimum_required(VERSION 3.20.0)

find_package(Zephyr REQUIRED HINTS $ENV{ZEPHYR_BASE})
project(ex_se05x_readIDList)

target_sources(app PRIVATE src/main.c ../src/ex_se05x_readIDList.c)
```

## sample.yaml
```
sample:
  description: se05x Read IDList example
  name: se05x_ReadIDList
common:
    harness: console
    harness_config:
      type: one_line
      regex:
        - "SE05x Read IDList Example Success"
tests:
  nxp-plugandtrust.examples.se05x_ReadIDList:
    extra_args:
      CONFIG_LOG=y
      CONFIG_PLUGANDTRUST_LOG_LEVEL_DBG=y
    platform_allow: frdm_k64f
    tags: se05x
```

## prj.conf
```kconfig
CONFIG_PLUGANDTRUST=y

CONFIG_PLUGANDTRUST_SCP03=n
CONFIG_PLUGANDTRUST_ECKEY=n
CONFIG_PLUGANDTRUST_ECKEY_SCP03=n
CONFIG_PLUGANDTRUST_SM_APDU_MUTEX=n

CONFIG_MAIN_STACK_SIZE=5000
CONFIG_GPIO=n
CONFIG_SPI=n

CONFIG_LOG=y
CONFIG_PLUGANDTRUST_LOG_LEVEL_DBG=n
CONFIG_LOG_MODE_IMMEDIATE=y
```

## boards/frdm_mcxn947_cpu0.overlay
```dts
/*
 * Copyright 2024 NXP
 * SPDX-License-Identifier: Apache-2.0
 */

/

{
	aliases {
		se05x-i2c = &flexcomm2_lpi2c2;
	};
};

&flexcomm2_lpi2c2 {
	status = "okay";
};
```

## src/main.c
```c
/** @file main.c
 *  @brief .
 *
 * Copyright 2024 NXP
 * SPDX-License-Identifier: Apache-2.0
 */

/* ********************** Include files ********************** */
#include <zephyr/kernel.h>
#include <zephyr/sys/printk.h>

/* ********************** Extern functions ********************** */
extern int ex_se05x_ReadIDList(void);

int main(void)
{
    printk("Se05x Read IDList Example ! %s\n", CONFIG_BOARD);
    if (ex_se05x_ReadIDList() != 0) {
        printk("SE05x Read IDList Example Failed !\n");
    }
    else {
        printk("SE05x Read IDList Example Success ! \n");
    }
    return 0;
}
```
