## CMakeLists.txt
```
# Copyright 2021-2024 NXP
# SPDX-License-Identifier: Apache-2.0

cmake_minimum_required(VERSION 3.20.0)

find_package(Zephyr REQUIRED HINTS $ENV{ZEPHYR_BASE})
project(ex_se05x_sign)

target_sources(app PRIVATE src/main.c ../src/ex_se05x_sign.c)
```

## sample.yaml
```
sample:
  description: se05x sign example
  name: se05x_sign
common:
    harness: console
    harness_config:
      type: one_line
      regex:
        - "SE05x Sign Example Success"
tests:
  nxp-plugandtrust.examples.se05x_sign:
    extra_args:
      CONFIG_LOG=y
      CONFIG_PLUGANDTRUST_LOG_LEVEL_DBG=y
    platform_allow: frdm_k64f
    tags: se05x
```

## prj.conf
```kconfig
CONFIG_PLUGANDTRUST=y

CONFIG_PLUGANDTRUST_SCP03=n
CONFIG_PLUGANDTRUST_ECKEY=n
CONFIG_PLUGANDTRUST_ECKEY_SCP03=n
CONFIG_PLUGANDTRUST_SM_APDU_MUTEX=n

CONFIG_MAIN_STACK_SIZE=850
#CONFIG_ISR_STACK_SIZE=100
CONFIG_IDLE_STACK_SIZE=220
CONFIG_SYSTEM_WORKQUEUE_STACK_SIZE=0
CONFIG_PRIVILEGED_STACK_SIZE=0
CONFIG_GPIO=n
CONFIG_SPI=n

CONFIG_LOG=n
CONFIG_PLUGANDTRUST_LOG_LEVEL_DBG=n
CONFIG_LOG_MODE_IMMEDIATE=n
```

## boards/lpcxpresso55s69_cpu0.overlay
```dts
/*
 * Copyright 2024 NXP
 * SPDX-License-Identifier: Apache-2.0
 */

 /

{
	aliases {
		se05x-i2c = &arduino_i2c;
	};
};

&arduino_i2c {
	status = "okay";
};
```

## src/main.c
```c
/** @file main.c
 *  @brief .
 *
 * Copyright 2021,2022,2024 NXP
 * SPDX-License-Identifier: Apache-2.0
 */

/* ********************** Include files ********************** */
#include <zephyr/kernel.h>
#include <zephyr/sys/printk.h>

/* ********************** Extern functions ********************** */
extern int ex_se05x_sign(void);

int main(void)
{
    printk("Se05x Sign Example ! %s\n", CONFIG_BOARD);
    if (ex_se05x_sign() != 0) {
        printk("SE05x Sign Example Failed !\n");
    }
    else {
        printk("SE05x Sign Example Success ! \n");
    }
    return 0;
}
```
