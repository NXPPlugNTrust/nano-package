## CMakeLists.txt
```
# Copyright 2021-2024 NXP
# SPDX-License-Identifier: Apache-2.0

cmake_minimum_required(VERSION 3.20.0)

find_package(Zephyr REQUIRED HINTS $ENV{ZEPHYR_BASE})
IF(CONFIG_PLUGANDTRUST_SCP03)
	project(ex_se05x_mandate_scp03_remove)
ELSE()
	project(ex_se05x_mandate_scp03_set)
ENDIF()

target_sources(app PRIVATE src/main.c ../src/ex_se05x_mandate_scp03.c ../src/ex_se05x_userId_APDU.c)

IF(CONFIG_PLUGANDTRUST_SCP03)
	message(STATUS "Building example to remove Mandate SCP03")
	add_definitions(-DWITH_PlatformSCPRequest_NOT_REQUIRED)
ELSE()
	message(STATUS "Building example to set Mandate SCP03")
	add_definitions(-DWITH_PlatformSCPRequest_REQUIRED)
ENDIF()
```

## sample.yaml
```
sample:
  description: se05x mandate scp03 example
  name: se05x_mandate_scp03
tests:
  nxp-plugandtrust.examples.se05x_mandate_scp03:
    platform_allow: frdm_k64f
    build_only: true
    tags: se05x
```

## prj.conf
```kconfig
CONFIG_PLUGANDTRUST=y
CONFIG_PLUGANDTRUST_SCP03=n

CONFIG_MAIN_STACK_SIZE=2000
CONFIG_GPIO=n
CONFIG_SPI=n

CONFIG_LOG=y
CONFIG_PLUGANDTRUST_LOG_LEVEL_DBG=n
CONFIG_LOG_MODE_IMMEDIATE=y
```

## src/main.c
```c
/** @file main.c
 *  @brief .
 *
 * Copyright 2021,2022,2024 NXP
 * SPDX-License-Identifier: Apache-2.0
 */

/* ********************** Include files ********************** */
#include <zephyr/kernel.h>
#include <zephyr/sys/printk.h>

/* ********************** Extern functions ********************** */
extern int ex_se05x_mandate_scp03();

int main(void)
{
    printk("Se05x Mandate SCP03 Example ! %s\n", CONFIG_BOARD);
    if (ex_se05x_mandate_scp03() != 0) {
        printk("SE05x Mandate SCP03 Example Failed !\n");
    }
    else {
        printk("SE05x Mandate SCP03 Example Success ! \n");
    }
    return 0;
}
```
