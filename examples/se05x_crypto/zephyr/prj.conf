## CMakeLists.txt
```
# Copyright 2021-2024 NXP
# SPDX-License-Identifier: Apache-2.0

cmake_minimum_required(VERSION 3.20.0)

find_package(Zephyr REQUIRED HINTS $ENV{ZEPHYR_BASE})
project(ex_se05x_crypto)

target_sources(app PRIVATE src/main.c ../src/ex_se05x_crypto.c)
```

## sample.yaml
```
sample:
  description: se05x crypto example
  name: se05x_crypto
common:
    harness: console
    harness_config:
      type: one_line
      regex:
        - "ex_nist256_sign_policy, PASSED"
tests:
  nxp-plugandtrust.examples.se05x_crypto:
    platform_allow: frdm_k64f
    tags: se05x
```

## prj.conf
```kconfig
CONFIG_PLUGANDTRUST=y

CONFIG_PLUGANDTRUST_SCP03=n
CONFIG_PLUGANDTRUST_ECKEY=n
CONFIG_PLUGANDTRUST_ECKEY_SCP03=n
CONFIG_PLUGANDTRUST_SM_APDU_MUTEX=n

CONFIG_PLUGANDTRUST_APDU_BUFFER_SIZE=512
CONFIG_MAIN_STACK_SIZE=4000
CONFIG_GPIO=n
CONFIG_SPI=n

CONFIG_LOG=y
CONFIG_PLUGANDTRUST_LOG_LEVEL_DBG=n
CONFIG_LOG_MODE_IMMEDIATE=y
```

## src/main.c
```c
/** @file main.c
 *  @brief .
 *
 * Copyright 2021,2022,2024 NXP
 * SPDX-License-Identifier: Apache-2.0
 */

/* ********************** Include files ********************** */
#include <zephyr/kernel.h>
#include <zephyr/sys/printk.h>

/* ********************** Extern functions ********************** */
extern int ex_se05x_crypto();

int main(void)
{
    printk("Se05x Crypto Example ! %s\n", CONFIG_BOARD);
    if (ex_se05x_crypto() != 0) {
        printk("SE05x crypto Example Failed !\n");
    }
    else {
        printk("SE05x crypto Example Success ! \n");
    }
    return 0;
}
```
