## zephyr/Kconfig
```kconfig
# SPDX-License-Identifier: Apache-2.0

config PLUGANDTRUST
	bool "PLUGANDTRUST Support"
	help
	  This option enables the PLUGANDTRUST library.
	select I2C
	select TINYCRYPT
	select TINYCRYPT_AES
	select TINYCRYPT_AES_CBC
	select TINYCRYPT_AES_CMAC
	select TINYCRYPT_CTR_PRNG
	select TINYCRYPT_ECC_DSA
	select TINYCRYPT_SHA256
	select TINYCRYPT_ECC_DH

config PLUGANDTRUST_SCP03
	bool "Enable secure channel for SE05x"
	help
	  This option enables secure channel for SE05x.

config PLUGANDTRUST_ECKEY
	bool "Enable EC Key Authentication for SE05x"
	help
	  This option enables EC Key Authentication for SE05x.

config PLUGANDTRUST_ECKEY_SCP03
	bool "Enable eckey + scp03 for SE05x"
	help
	  This option enables eckey + scp03 for SE05x.

config PLUGANDTRUST_SM_APDU_MUTEX
	bool "Enable Mutex at APDU layer"
	help
		This option enable mutex at APDU layer.

config PLUGANDTRUST_MBEDTLS_ALT
	bool "Use ALT implementation for mbedTLS of SE05x"
	help
	  This option enables secure channel for SE05x.

config PLUGANDTRUST_APDU_BUFFER_SIZE
	int "Max APDU buffer size"
	default 255
	help
	  Max APDU buffer size.

module = PLUGANDTRUST
module-str = plugandtrust
source "subsys/logging/Kconfig.template.log_config"
```

## zephyr/west.yml
```yaml
manifest:

  remotes:
    - name: zephyrproject-rtos
      url-base: https://github.com/zephyrproject-rtos

  projects:
    - name: zephyr
      remote: zephyrproject-rtos
      revision: v3.7.0
      import:
        name-allowlist:
          - cmsis
          - hal_nxp
          - tinycrypt
          - segger

  self:
    path: modules/crypto/nxp-plugandtrust/
```
