## CMakeLists.txt
```
# Copyright 2021-2024 NXP
# SPDX-License-Identifier: Apache-2.0

cmake_minimum_required(VERSION 3.20.0)

find_package(Zephyr REQUIRED HINTS $ENV{ZEPHYR_BASE})
project(se05x_tests)

FILE(GLOB app_sources src/*.c ../src/*.c)
target_sources(app PRIVATE ${app_sources})

zephyr_include_directories(../src)
```

## sample.yaml
```
sample:
  description: SE05x tests
  name: se05x_tests
common:
    tags: introduction
    harness_config:
      type: one_line
      regex:
        - "se05x tests! (.*)"
```

## prj.conf
```kconfig
CONFIG_ZTEST=y
# CONFIG_ZTEST_NEW_API=y
CONFIG_ZTEST_STACK_SIZE=5000
CONFIG_MAIN_STACK_SIZE=3000

CONFIG_PLUGANDTRUST=y
CONFIG_I2C=y
CONFIG_PLUGANDTRUST_SCP03=n

CONFIG_TINYCRYPT=y
CONFIG_TINYCRYPT_AES=y
CONFIG_TINYCRYPT_AES_CBC=y
CONFIG_TINYCRYPT_AES_CMAC=y
CONFIG_TINYCRYPT_CTR_PRNG=y

CONFIG_LOG=y
CONFIG_PLUGANDTRUST_LOG_LEVEL_DBG=n
CONFIG_LOG_MODE_IMMEDIATE=y
```

## boards/frdm_mcxn947_cpu0.overlay
```dts
/*
 * Copyright 2024 NXP
 * SPDX-License-Identifier: Apache-2.0
 */

 /

{
	aliases {
		se05x-i2c = &flexcomm2_lpi2c2;
	};
};

&flexcomm2_lpi2c2 {
	status = "okay";
};
```

## src/main.c
```c
/** @file main.c
 *  @brief Unit tests.
 *
 * Copyright 2022,2024 NXP
 * SPDX-License-Identifier: Apache-2.0
 */

#include <zephyr/ztest.h>
#include "test_se05x.h"

void test_fail(void)
{
    ztest_test_fail();
}

ZTEST_SUITE(se05x_tests, NULL, test_setup, NULL, NULL, test_teardown);

ZTEST(se05x_tests, test_run_se05x_nist256_ecdh)
{
    uint8_t pass   = 0;
    uint8_t fail   = 0;
    uint8_t ignore = 0;
    test_se05x_nist256_ecdh(&se05x_session, &pass, &fail, &ignore);
    zassert_equal(fail, 0, "test_run_se05x_nist256_ecdh failed");
}

ZTEST(se05x_tests, test_run_se05x_misc)
{
    uint8_t pass   = 0;
    uint8_t fail   = 0;
    uint8_t ignore = 0;
    test_se05x_misc(&se05x_session, &pass, &fail, &ignore);
    zassert_equal(fail, 0, "test_run_se05x_misc failed");
}

ZTEST(se05x_tests, test_run_se05x_aes)
{
    uint8_t pass   = 0;
    uint8_t fail   = 0;
    uint8_t ignore = 0;
    test_se05x_aes(&se05x_session, &pass, &fail, &ignore);
    zassert_equal(fail, 0, "test_run_se05x_aes failed");
}

ZTEST(se05x_tests, test_run_se05x_bin_objects)
{
    uint8_t pass   = 0;
    uint8_t fail   = 0;
    uint8_t ignore = 0;
    test_se05x_bin_objects(&se05x_session, &pass, &fail, &ignore);
    zassert_equal(fail, 0, "test_run_se05x_bin_objects failed");
}

ZTEST(se05x_tests, test_run_se05x_nist256_ecdsa)
{
    uint8_t pass   = 0;
    uint8_t fail   = 0;
    uint8_t ignore = 0;
    test_se05x_nist256_ecdsa(&se05x_session, &pass, &fail, &ignore);
    zassert_equal(fail, 0, "test_run_se05x_nist256_ecdsa failed");
}

ZTEST(se05x_tests, test_run_se05x_nist256)
{
    uint8_t pass   = 0;
    uint8_t fail   = 0;
    uint8_t ignore = 0;
    test_se05x_nist256(&se05x_session, &pass, &fail, &ignore);
    zassert_equal(fail, 0, "test_run_se05x_nist256 failed");
}
```
